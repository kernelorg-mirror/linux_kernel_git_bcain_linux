## Documentation/devicetree/bindings/clock/qcom,qcs6490-cdsp-q6cc.yaml
```yaml
# SPDX-License-Identifier: (GPL-2.0-only OR BSD-2-Clause)
%YAML 1.2
---
$id: http://devicetree.org/schemas/clock/qcom,qcs6490-cdsp-q6cc.yaml#
$schema: http://devicetree.org/meta-schemas/core.yaml#

title: Qualcomm QCS6490 CDSP core clock

maintainers:
  - Brian Cain <brian.cain@oss.qualcomm.com>

description:
  The clock controller of the QCS6490 CDSP's Turing QDSP6 subsystem, seen by a
  Linux that runs on the DSP.  The core comes out of reset on the 19.2 MHz
  reference clock; the driver starts the subsystem's PLL and moves the core
  clock onto it, unless something has done so already.  The core clock is the
  clock the node provides.

properties:
  compatible:
    const: qcom,qcs6490-cdsp-q6cc

  reg:
    maxItems: 1

  '#clock-cells':
    const: 0

  qcom,pll-l-val:
    $ref: /schemas/types.yaml#/definitions/uint32
    description: PLL multiplier, of the 19.2 MHz reference clock

  qcom,pll-cal-l-val:
    $ref: /schemas/types.yaml#/definitions/uint32
    description: PLL multiplier used while the PLL calibrates

required:
  - compatible
  - reg
  - '#clock-cells'
  - qcom,pll-l-val
  - qcom,pll-cal-l-val

additionalProperties: false

examples:
  - |
    clock-controller@a340000 {
        compatible = "qcom,qcs6490-cdsp-q6cc";
        reg = <0x0a340000 0x10000>;
        #clock-cells = <0>;
        qcom,pll-l-val = <0x31>;
        qcom,pll-cal-l-val = <0x44>;
    };
```

## Documentation/devicetree/bindings/hexagon/qcom,hexagon-virt.yaml
```yaml
# SPDX-License-Identifier: (GPL-2.0-only OR BSD-2-Clause)
%YAML 1.2
---
$id: http://devicetree.org/schemas/hexagon/qcom,hexagon-virt.yaml#
$schema: http://devicetree.org/meta-schemas/core.yaml#

title: Qualcomm Hexagon QEMU Virtual Machine

maintainers:
  - Brian Cain <bcain@quicinc.com>

description:
  The Hexagon QEMU virt machine is a virtual platform for running Linux
  on the Qualcomm Hexagon DSP architecture under QEMU system emulation.

properties:
  $nodename:
    const: /
  compatible:
    items:
      - const: qcom,hexagon-virt

required:
  - compatible

additionalProperties: true
```

## Documentation/devicetree/bindings/interrupt-controller/qcom,h2-pic.yaml
```yaml
# SPDX-License-Identifier: (GPL-2.0-only OR BSD-2-Clause)
%YAML 1.2
---
$id: http://devicetree.org/schemas/interrupt-controller/qcom,h2-pic.yaml#
$schema: http://devicetree.org/meta-schemas/core.yaml#

title: Qualcomm Hexagon H2 hypervisor interrupt controller

maintainers:
  - Brian Cain <brian.cain@oss.qualcomm.com>

description: >
  First-level interrupt controller as presented to a guest by the Hexagon H2
  hypervisor.  The hypervisor virtualizes the controller entirely: masking,
  unmasking and end-of-interrupt are vmintop hypercalls and the pending
  interrupt is reported in the event record, so the node carries no register
  block.

properties:
  compatible:
    items:
      - const: qcom,h2-pic
      - const: qcom,hvm-pic
    description: >
      qcom,hvm-pic is a generic fallback for any Hexagon hypervisor PIC:
      it lets a driver bind against the interrupt controller a future H2
      revision presents without gaining a new specific compatible string
      for every revision.  The in-tree driver currently matches only the
      specific qcom,h2-pic string.

  '#address-cells':
    const: 0

  '#interrupt-cells':
    const: 2
    description: >
      The first cell is the hardware interrupt number, the second the
      trigger type as defined in interrupt-controller/irq.h.

  interrupt-controller: true

required:
  - compatible
  - '#address-cells'
  - '#interrupt-cells'
  - interrupt-controller

additionalProperties: false

examples:
  - |
    interrupt-controller {
        compatible = "qcom,h2-pic", "qcom,hvm-pic";
        interrupt-controller;
        #address-cells = <0>;
        #interrupt-cells = <2>;
    };
```

## Documentation/devicetree/bindings/remoteproc/qcom,glink-shmem-edge.yaml
```yaml
# SPDX-License-Identifier: (GPL-2.0-only OR BSD-2-Clause)
%YAML 1.2
---
$id: http://devicetree.org/schemas/remoteproc/qcom,glink-shmem-edge.yaml#
$schema: http://devicetree.org/meta-schemas/core.yaml#

title: Qualcomm GLINK edge over shared memory

maintainers:
  - Brian Cain <brian.cain@oss.qualcomm.com>

description:
  A GLINK edge whose two FIFOs live in windows of shared memory, one per
  direction, and whose peer is kicked by writing a bit of a doorbell
  register.  Unlike the SMEM based edge it needs no SMEM, IPCC or hwspinlock.
  Each window starts with a 16 byte header, the FIFO head at offset 0, the
  FIFO tail at offset 4 and the magic 0x4d534c47 at offset 8, and the FIFO
  fills the rest of the window.

properties:
  compatible:
    const: qcom,glink-shmem-edge

  reg:
    items:
      - description: window this side receives from
      - description: window this side transmits to
      - description: block holding the doorbell register that kicks the peer

  interrupts:
    maxItems: 1
    description: raised by the peer's doorbell

  qcom,ipc-offset:
    $ref: /schemas/types.yaml#/definitions/uint32
    description: offset of the doorbell register in the third reg region

  qcom,ipc-bits:
    $ref: /schemas/types.yaml#/definitions/uint32
    description: value written to the doorbell register to kick the peer

  qcom,shmem-init:
    type: boolean
    description:
      This side initializes both windows.  Without it the windows must
      already have been initialized by the peer.

  qcom,intentless:
    type: boolean
    description: use GLINK's intentless mode; both sides must agree

patternProperties:
  "^[a-z][a-z0-9-]*$":
    type: object
    description: a channel of the edge
    properties:
      qcom,glink-channels:
        $ref: /schemas/types.yaml#/definitions/string-array
        description: name of the channel
      qcom,glink-auto-open:
        type: boolean
        description:
          Open the channel from this side once the version negotiation is
          done, for a peer that does not open it itself.

required:
  - compatible
  - reg
  - interrupts
  - qcom,ipc-offset
  - qcom,ipc-bits

additionalProperties: false

examples:
  - |
    soc {
        #address-cells = <2>;
        #size-cells = <2>;

        glink-edge@d7c00000 {
            compatible = "qcom,glink-shmem-edge";
            reg = <0 0xd7c00000 0 0x10000>,
                  <0 0xd7c10000 0 0x10000>,
                  <0 0x0a380000 0 0x10000>;
            interrupts = <91 0>;
            qcom,ipc-offset = <0x8000>;
            qcom,ipc-bits = <0x20>;
            qcom,shmem-init;
            qcom,intentless;

            ip-bridge {
                qcom,glink-channels = "IP_BRIDGE";
                qcom,glink-auto-open;
            };
        };
    };
```

## Documentation/devicetree/bindings/timer/qcom,h2-timer.yaml
```yaml
# SPDX-License-Identifier: (GPL-2.0-only OR BSD-2-Clause)
%YAML 1.2
---
$id: http://devicetree.org/schemas/timer/qcom,h2-timer.yaml#
$schema: http://devicetree.org/meta-schemas/core.yaml#

title: Qualcomm Hexagon H2 hypervisor timer

maintainers:
  - Brian Cain <brian.cain@oss.qualcomm.com>

description: >
  Timer presented to a guest by the Hexagon H2 hypervisor.  The guest reads
  the counter and arms the deadline through the vmtimerop hypercall rather
  than through the register block, so a driver needs only the interrupt the
  hypervisor raises when the deadline expires.  The register block belongs
  to the underlying general purpose timer and is never mapped by a guest,
  so the node carries no reg.

properties:
  compatible:
    items:
      - const: qcom,h2-timer
      - const: qcom,hvm-timer
    description: >
      qcom,hvm-timer is a generic fallback for any Hexagon hypervisor
      timer: it lets a driver bind against the timer a future H2 revision
      presents without gaining a new specific compatible string for every
      revision.  The in-tree driver currently matches only the specific
      qcom,h2-timer string.

  interrupts:
    maxItems: 1

required:
  - compatible
  - interrupts

additionalProperties: false

examples:
  - |
    timer {
        compatible = "qcom,h2-timer", "qcom,hvm-timer";
        interrupts = <12 0>;
    };
```

## arch/hexagon/Kconfig
```kconfig
# SPDX-License-Identifier: GPL-2.0
# Hexagon configuration
comment "Linux Kernel Configuration for Hexagon"

config HEXAGON
	def_bool y
	select ARCH_32BIT_OFF_T
	select ARCH_HAS_DELAY_TIMER
	select ARCH_HAS_SYNC_DMA_FOR_DEVICE
	select ARCH_NO_PREEMPT
	select ARCH_WANT_FRAME_POINTERS
	select ARCH_HAS_SYSCALL_WRAPPER
	select ARCH_HAS_UBSAN
	select HAVE_ARCH_KASAN if !HEXAGON_SPLIT_2GB
	select ARCH_SUPPORTS_CFI
	select ARCH_USES_CFI_TRAPS if CFI
	select ARCH_SUPPORTS_SHADOW_CALL_STACK
	select DMA_GLOBAL_POOL
	select HAVE_PAGE_SIZE_4KB
	select HAVE_PAGE_SIZE_16KB
	select HAVE_PAGE_SIZE_64KB
	select HAVE_PAGE_SIZE_256KB
	select FRAME_POINTER
	# Other pending projects/to-do items.
	select HAVE_REGS_AND_STACK_ACCESS_API
	# select HAVE_HW_BREAKPOINT if PERF_EVENTS
	# select ARCH_HAS_CPU_IDLE_WAIT
	# select GPIOLIB
	# select HAVE_CLK
	select GENERIC_ATOMIC64
	select HAVE_EBPF_JIT
	select HAVE_PERF_EVENTS
	# GENERIC_ALLOCATOR is used by dma_alloc_coherent()
	select GENERIC_ALLOCATOR
	select GENERIC_IRQ_PROBE
	select GENERIC_IRQ_SHOW
	select HAVE_ARCH_KGDB
	select HAVE_ARCH_TRACEHOOK
	select HAVE_SYSCALL_TRACEPOINTS
	select NEED_SG_DMA_LENGTH
	select GENERIC_IOREMAP
	select GENERIC_SMP_IDLE_THREAD
	select STACKTRACE_SUPPORT
	select GENERIC_CLOCKEVENTS_BROADCAST
	select LOCK_MM_AND_FIND_VMA
	select MODULES_USE_ELF_RELA
	select GENERIC_CPU_DEVICES
	select ARCH_WANT_LD_ORPHAN_WARN
	select TRACE_IRQFLAGS_SUPPORT
	select IRQ_DOMAIN
	select OF
	select OF_EARLY_FLATTREE
	help
	  Qualcomm Hexagon is a processor architecture designed for high
	  performance and low power across a wide variety of applications.

config KASAN_SHADOW_OFFSET
	hex
	depends on KASAN
	default 0xde400000
	help
	  KASAN maps an address to its shadow byte with
	  (addr >> 3) + KASAN_SHADOW_OFFSET.  The value here places the
	  shadow of the kernel map at KASAN_SHADOW_START; the two are
	  derived from each other in <asm/kasan.h>, so they must be changed
	  together.

config HEXAGON_PHYS_OFFSET
	def_bool y
	help
	  Platforms that don't load the kernel at zero set this.

config LOCKDEP_SUPPORT
	def_bool y

config EARLY_PRINTK
	def_bool y

config MMU
	def_bool y

config NO_IOPORT_MAP
	def_bool y

config GENERIC_CSUM
	def_bool y

config GENERIC_CALIBRATE_DELAY
	def_bool y

config GENERIC_HWEIGHT
	def_bool y

config STACKTRACE_SUPPORT
	def_bool y
	select STACKTRACE

config GENERIC_BUG
	def_bool y
	depends on BUG

menu "Machine selection"

choice
	prompt "System type"
	default HEXAGON_COMET

config HEXAGON_QEMU
	bool "QEMU virt machine"
	select HEXAGON_PHYS_OFFSET
	select ARM_AMBA
	select COMMON_CLK
	select HEXAGON_H2
	help
	  Support for the QEMU hexagon "virt" machine.

config HEXAGON_QCS6490_CDSP
	bool "Qualcomm QCS6490 Compute DSP"
	select HEXAGON_PHYS_OFFSET
	select ARM_AMBA
	select COMMON_CLK
	select HEXAGON_H2
	help
	  Support for the Hexagon v68 compute DSP of the Qualcomm QCS6490,
	  running as a guest of the H2 hypervisor.  The console is the
	  PL011 that QEMU's qcs6490-cdsp machine adds for this purpose; the
	  hardware has no UART.

config HEXAGON_SM8975_NSP
	bool "Qualcomm SM8975 NSP"
	select HEXAGON_PHYS_OFFSET
	select ARM_AMBA
	select COMMON_CLK
	select HEXAGON_H2
	help
	  Support for the SM8975 NSP running under the H2 hypervisor.
	  The supplied device tree describes QEMU's sm8975-nsp machine,
	  including its emulated PL011 console.

config HEXAGON_COMET
	bool "Comet Board"
	help
	  Support for the Comet platform.

endchoice

config HEXAGON_ARCH_VERSION
	int "Architecture version"
	default 2

config CMDLINE
	string "Default kernel command string"
	default ""
	help
	  On some platforms, there is currently no way for the boot loader
	  to pass arguments to the kernel. For these, you should supply some
	  command-line options at build time by entering them here.  At a
	  minimum, you should specify the memory size and the root device
	  (e.g., mem=64M root=/dev/nfs).

config HEXAGON_PMU
	bool "Hexagon performance monitoring unit (perf)"
	depends on HEXAGON_H2 && PERF_EVENTS
	default y
	help
	  Support for the core's performance counters in perf, through the
	  hypervisor: a PMU named "hexagon", counting the whole core.

config HEXAGON_H2_INFO
	bool "Hypervisor and core information in sysfs and debugfs"
	depends on HEXAGON_H2
	default y
	help
	  Export what the hypervisor tells a guest about itself and the core it
	  runs on, and the state of the core's performance monitoring unit, in
	  /sys/kernel/hexagon and, with debugfs, /sys/kernel/debug/hexagon.

config HEXAGON_H2
	bool "H2 hypervisor interface"
	help
	  Support for running under the Hexagon H2 hypervisor (as opposed
	  to bare metal or an older/simpler VM interface). This provides
	  the trap-based hypercall interface, the H2 interrupt controller,
	  and the H2 timer that the QEMU "virt" machine and current
	  hardware targets require. Platforms without an H2 hypervisor
	  should leave this disabled.

config SMP
	bool "Multi-Processing support"
	help
	  Enables SMP support in the kernel.  If unsure, say "Y"

config NR_CPUS
	int "Maximum number of CPUs" if SMP
	range 2 16 if SMP
	default "1" if !SMP
	default "6" if SMP
	help
	  This allows you to specify the maximum number of CPUs which this
	  kernel will support.  The maximum supported value is 16 and the
	  minimum value which makes sense is 2.

	  This is purely to save memory - each supported CPU adds
	  approximately eight kilobytes to the kernel image.

config BASE_IPI_IRQ
	int "Base IPI IRQ" if SMP
	range 0 11 if HEXAGON_H2
	default 0
	help
	  The IRQ used for IPI calls. H2 uses the same per-CPU IRQ on
	  every CPU; other hypervisors increment the base for each CPU.

	  The IRQs used by IPIs must not overlap interrupts claimed by
	  devices. For H2, interrupt 12 is reserved for the timer.

	  Todo:  Maybe make this a devtree thing instead?

source "kernel/Kconfig.hz"

source "arch/hexagon/kernel/hvx/Kconfig"

source "arch/hexagon/kernel/hmx/Kconfig"

config HEXAGON_HLX
	bool "Userspace HLX context management"
	depends on HEXAGON_H2
	select HAVE_EXIT_THREAD
	help
	  Allocate HLX contexts on demand and preserve their register state
	  across task switches.

endmenu
```
