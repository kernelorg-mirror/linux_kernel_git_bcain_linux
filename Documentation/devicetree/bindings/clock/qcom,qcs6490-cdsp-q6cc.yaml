## arch/hexagon/configs/sa8775p_cdsp0_defconfig
```kconfig
CONFIG_HEXAGON_SA8775P_CDSP0=y
CONFIG_HEXAGON_LLVM=y
CONFIG_USE_OF=y
CONFIG_CMDLINE="console=ttyAMA0 console=ttyMSM0,115200n8 maxcpus=1 debug mem=892M"
CONFIG_H2=y
CONFIG_HEXAGON_ANGEL_TRAPS=y
CONFIG_SMP=y
CONFIG_NR_CPUS=6
CONFIG_PAGE_SIZE_64KB=y
# CONFIG_HEXAGON_HVX is not set
CONFIG_DEFAULT_MMAP_MIN_ADDR=0
CONFIG_HZ_100=y
CONFIG_CROSS_COMPILE="hexagon-"
CONFIG_LOCALVERSION="-sa8775p-cdsp0"
# CONFIG_LOCALVERSION_AUTO is not set
CONFIG_DEFAULT_HOSTNAME="sa8775p-cdsp0"
# CONFIG_SYSVIPC is not set
# CONFIG_USELIB is not set
# CONFIG_IKCONFIG is not set
CONFIG_LOG_BUF_SHIFT=16
CONFIG_BLK_DEV_INITRD=y
CONFIG_INITRAMFS_SOURCE="arch/hexagon/configs/qemu_initramfs.list"
CONFIG_KALLSYMS_ALL=y
CONFIG_EMBEDDED=y
# CONFIG_VM_EVENT_COUNTERS is not set
# CONFIG_MODULES is not set
# CONFIG_BLK_DEV_BSG is not set
CONFIG_DEVTMPFS=y
CONFIG_DEVTMPFS_MOUNT=y
# CONFIG_STANDALONE is not set
# CONFIG_INPUT_MOUSEDEV is not set
# CONFIG_INPUT_KEYBOARD is not set
# CONFIG_INPUT_MOUSE is not set
# CONFIG_INPUT is not set
# CONFIG_SERIO is not set
# CONFIG_CONSOLE_TRANSLATIONS is not set
# CONFIG_LEGACY_PTYS is not set
# CONFIG_DEVKMEM is not set
CONFIG_SERIAL_QCOM_GENI=y
CONFIG_SERIAL_QCOM_GENI_CONSOLE=y
CONFIG_QCOM_GENI_SE=y
CONFIG_SERIAL_AMBA_PL011=y
CONFIG_SERIAL_AMBA_PL011_CONSOLE=y
# CONFIG_HW_RANDOM is not set
# CONFIG_HWMON is not set
# CONFIG_VGA_CONSOLE is not set
# CONFIG_USB_SUPPORT is not set
# CONFIG_HID_SUPPORT is not set
# CONFIG_HID is not set
# CONFIG_UIO is not set
CONFIG_COMMON_CLK=y
# CONFIG_VIRT_DRIVERS is not set
# CONFIG_VIRTIO_MMIO is not set
# CONFIG_IOMMU_SUPPORT is not set
# CONFIG_EXT2_FS is not set
# CONFIG_EXT3_FS is not set
# CONFIG_MISC_FILESYSTEMS is not set
# CONFIG_CORE_DUMP_DEFAULT_ELF_HEADERS is not set
# CONFIG_CRYPTO_ECHAINIV is not set
# CONFIG_CRYPTO_HW is not set
CONFIG_PRINTK_TIME=y
CONFIG_MESSAGE_LOGLEVEL_DEFAULT=7
CONFIG_DEBUG_INFO=y
CONFIG_FRAME_WARN=0
# CONFIG_DEBUG_FS is not set
# CONFIG_SCHED_DEBUG is not set
# CONFIG_DEBUG_BUGVERBOSE is not set
# CONFIG_FTRACE is not set
# CONFIG_IO_URING is not set
```

## arch/hexagon/configs/sm8150_defconfig
```kconfig
CONFIG_HEXAGON_SM8150=y
CONFIG_HEXAGON_LLVM=y
CONFIG_USE_OF=y
CONFIG_CMDLINE="maxcpus=4 debug mem=892M nfseth=sn0 root=/dev/nfs rw ip=dhcp nfsroot=10.222.150.11:/prj/dsp/austin/hexagon_farm/rootfs/dev/symlinks,tcp,nolock,v3"
CONFIG_H2=y
CONFIG_SMP=y
CONFIG_NR_CPUS=4
CONFIG_PAGE_SIZE_64KB=y
CONFIG_HEXAGON_HVX=y
CONFIG_DEFAULT_MMAP_MIN_ADDR=0
CONFIG_HZ_100=y
CONFIG_CROSS_COMPILE="hexagon-"
CONFIG_LOCALVERSION="-smp"
# CONFIG_LOCALVERSION_AUTO is not set
CONFIG_SYSVIPC=y
CONFIG_POSIX_MQUEUE=y
CONFIG_FHANDLE=y
# CONFIG_USELIB is not set
CONFIG_BSD_PROCESS_ACCT=y
CONFIG_BSD_PROCESS_ACCT_V3=y
CONFIG_TASKSTATS=y
CONFIG_TASK_DELAY_ACCT=y
CONFIG_IKCONFIG=y
CONFIG_IKCONFIG_PROC=y
CONFIG_LOG_BUF_SHIFT=18
CONFIG_KALLSYMS_ALL=y
CONFIG_EMBEDDED=y
# CONFIG_VM_EVENT_COUNTERS is not set
CONFIG_MODULES=y
# CONFIG_BLK_DEV_BSG is not set
CONFIG_UEVENT_HELPER_PATH="/sbin/hotplug"
# CONFIG_STANDALONE is not set
CONFIG_BLK_DEV_LOOP=y
CONFIG_BLK_DEV_NBD=y
CONFIG_NETDEVICES=y
# CONFIG_NET_VENDOR_ARC is not set
# CONFIG_NET_CADENCE is not set
# CONFIG_NET_VENDOR_BROADCOM is not set
# CONFIG_NET_VENDOR_EZCHIP is not set
# CONFIG_NET_VENDOR_INTEL is not set
# CONFIG_NET_VENDOR_MARVELL is not set
# CONFIG_NET_VENDOR_MICREL is not set
# CONFIG_NET_VENDOR_NATSEMI is not set
# CONFIG_NET_VENDOR_QUALCOMM is not set
# CONFIG_NET_VENDOR_RENESAS is not set
# CONFIG_NET_VENDOR_ROCKER is not set
# CONFIG_NET_VENDOR_SAMSUNG is not set
# CONFIG_NET_VENDOR_SEEQ is not set
# CONFIG_NET_VENDOR_STMICRO is not set
# CONFIG_NET_VENDOR_VIA is not set
# CONFIG_NET_VENDOR_WIZNET is not set
CONFIG_NET_SNULL=y
# CONFIG_WLAN is not set
# CONFIG_INPUT_MOUSEDEV is not set
# CONFIG_INPUT_KEYBOARD is not set
# CONFIG_INPUT_MOUSE is not set
# CONFIG_SERIO is not set
# CONFIG_CONSOLE_TRANSLATIONS is not set
CONFIG_LEGACY_PTY_COUNT=64
# CONFIG_DEVKMEM is not set
# CONFIG_HW_RANDOM is not set
# CONFIG_HWMON is not set
# CONFIG_VGA_CONSOLE is not set
# CONFIG_USB_SUPPORT is not set
CONFIG_UIO=y
CONFIG_UIO_HEXAGON_SHBUF=y
CONFIG_UIO_HEXAGON_VTCM=y
# CONFIG_IOMMU_SUPPORT is not set
CONFIG_QUOTA=y
CONFIG_AUTOFS4_FS=y
CONFIG_PROC_KCORE=y
CONFIG_TMPFS=y
CONFIG_TMPFS_POSIX_ACL=y
CONFIG_HUGETLBFS=y
# CONFIG_MISC_FILESYSTEMS is not set
CONFIG_NFS_FS=y
CONFIG_NFS_V3_ACL=y
CONFIG_ROOT_NFS=y
# CONFIG_CORE_DUMP_DEFAULT_ELF_HEADERS is not set
CONFIG_NET=y
CONFIG_PACKET=y
CONFIG_UNIX=y
CONFIG_INET=y
CONFIG_IP_PNP=y
CONFIG_IP_PNP_DHCP=y
# CONFIG_INET_XFRM_MODE_TRANSPORT is not set
# CONFIG_INET_XFRM_MODE_TUNNEL is not set
# CONFIG_INET_XFRM_MODE_BEET is not set
# CONFIG_INET_DIAG is not set
# CONFIG_IPV6 is not set
# CONFIG_WIRELESS is not set
CONFIG_CRYPTO_ECHAINIV=y
CONFIG_CRYPTO_MD5=y
# CONFIG_CRYPTO_HW is not set
CONFIG_CRC_CCITT=y
CONFIG_CRC16=y
CONFIG_CRC_T10DIF=y
CONFIG_LIBCRC32C=y
CONFIG_XZ_DEC=y
CONFIG_DEBUG_INFO=y
CONFIG_FRAME_WARN=0
CONFIG_DEBUG_FS=y
CONFIG_MAGIC_SYSRQ=y
# CONFIG_SCHED_DEBUG is not set
CONFIG_DEBUG_RT_MUTEXES=y
CONFIG_DEBUG_MUTEXES=y
```

## arch/hexagon/configs/sm8975_nsp_defconfig
```kconfig
CONFIG_HEXAGON_SM8975_NSP=y
CONFIG_HEXAGON_ARCH_VERSION=81
CONFIG_CMDLINE="console=ttyAMA0 mem=480M lpj=89124080"
CONFIG_SMP=y
CONFIG_NR_CPUS=16
CONFIG_PAGE_SIZE_64KB=y
CONFIG_HZ_100=y
CONFIG_DEFAULT_HOSTNAME="sm8975-nsp"
CONFIG_LOG_BUF_SHIFT=18
CONFIG_BLK_DEV_INITRD=y
CONFIG_KALLSYMS_ALL=y
CONFIG_NET=y
CONFIG_PACKET=y
CONFIG_UNIX=y
CONFIG_INET=y
CONFIG_DEVTMPFS=y
CONFIG_DEVTMPFS_MOUNT=y
CONFIG_HEXAGON_HVX=y
CONFIG_HEXAGON_HMX=y
CONFIG_HEXAGON_HLX=y
CONFIG_UIO=y
CONFIG_UIO_HEXAGON_VTCM=y
CONFIG_SERIAL_AMBA_PL011=y
CONFIG_SERIAL_AMBA_PL011_CONSOLE=y
CONFIG_VIRTIO_MMIO=y
CONFIG_VIRTIO_BLK=y
CONFIG_EXT2_FS=y
CONFIG_TMPFS=y
# CONFIG_INPUT is not set
# CONFIG_SERIO is not set
# CONFIG_HW_RANDOM is not set
# CONFIG_HWMON is not set
# CONFIG_USB_SUPPORT is not set
# CONFIG_IOMMU_SUPPORT is not set
# CONFIG_MISC_FILESYSTEMS is not set
# CONFIG_NETWORK_FILESYSTEMS is not set
CONFIG_PRINTK_TIME=y
```

## arch/hexagon/kernel/hmx/Kconfig
```kconfig
config HEXAGON_HMX
	tristate "Hexagon HMX Module"
	help
	  Modular support for Hexagon HMX (Hexagon Matrix eXtension)
	  instructions.  Provides coprocessor context management via
	  the thread notification framework, enabling/disabling HMX
	  hardware access on a per-thread basis through HWCONFIG.
```

## arch/hexagon/kernel/hvx/Kconfig
```kconfig
config HEXAGON_HVX
	tristate "Hexagon HVX Module"
	help
	  Modular support for Hexagon HVX coprocessor context management.
	  HVX (Hexagon Vector eXtensions) provides SIMD vector processing
	  with 128-byte vector registers.  This module handles per-thread
	  context save/restore, lazy allocation on coprocessor fault, and
	  hardware configuration via the H2 hypervisor HWCONFIG interface.
```
